## main/Kconfig.projbuild
```kconfig
menu "OneWheelMonitor Configuration"

    config OWM_ENABLE_DISPLAY
        bool "Enable I2C Display Output Interface"
        default false

    config OWM_ENABLE_MQTT
        bool "Enable MQTT Output Interface"
        default false

endmenu
```

## sdkconfig.defaults
```kconfig
CONFIG_BT_ENABLED=y
CONFIG_BTDM_CTRL_MODE_BR_EDR_ONLY=n
CONFIG_BTDM_CTRL_MODE_BTDM=n

CONFIG_ESPTOOLPY_FLASHSIZE_4MB=y
CONFIG_PARTITION_TABLE_CUSTOM=y
CONFIG_PARTITION_TABLE_CUSTOM_FILENAME="partition_table.csv"
CONFIG_PARTITION_TABLE_FILENAME="partition_table.csv"

########################################################################################################################
# EBLi

CONFIG_ENABLE_EBLI_FS=y
CONFIG_ENABLE_EBLI_WIFI=y
CONFIG_ENABLE_EBLI_MQTT=y
CONFIG_EBLI_MQTT_DEFAULT_BROKER="black-pearl"
CONFIG_EBLI_MQTT_DEFAULT_DEVICE_TOPIC="owm"
CONFIG_EBLI_MQTT_DEFAULT_GROUP_TOPIC="all-owms"

########################################################################################################################
# OWM

# CONFIG_OWM_ENABLE_DISPLAY
CONFIG_OWM_ENABLE_MQTT=y
```
